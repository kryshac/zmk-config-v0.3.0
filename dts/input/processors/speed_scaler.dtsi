/*
 * Copyright (c) 2026
 *
 * SPDX-License-Identifier: MIT
 */

#include <zephyr/dt-bindings/input/input-event-codes.h>

/ {
    /omit-if-no-ref/ zip_xy_speed_scaler: zip_xy_speed_scaler {
        compatible = "zmk,input-processor-speed-scaler";
        #input-processor-cells = <0>;
        type = <INPUT_EV_REL>;
        codes = <INPUT_REL_X INPUT_REL_Y>;
        debug-log-interval-ms = <250>;

        low-speed = <300>;
        high-speed = <1700>;
        timeout-ms = <35>;
        minimum-dt-ms = <5>;
        curve-exponent = <3>;

        slow-multiplier = <1>;
        slow-divisor = <3>;
        fast-multiplier = <1>;
        fast-divisor = <1>;
    };
};
