## dts/bindings/behaviors/zmk,behavior-led-hsb-adjust.yaml
```yaml
# SPDX-License-Identifier: MIT

description: Adjust base layer LED hue, saturation, or brightness

compatible: "zmk,behavior-led-hsb-adjust"

include: one_param.yaml
```

## dts/bindings/behaviors/zmk,behavior-led-layer-sync.yaml
```yaml
# SPDX-License-Identifier: MIT

description: Sync LED layer rendering to a peripheral

compatible: "zmk,behavior-led-layer-sync"

include: one_param.yaml
```

## dts/bindings/input_processors/zmk,input-processor-speed-scaler.yaml
```yaml
# Copyright (c) 2026
# SPDX-License-Identifier: MIT

description: Input processor for speed-based pointer scaling

compatible: "zmk,input-processor-speed-scaler"

include: ip_zero_param.yaml

properties:
  type:
    type: int
    required: true
  codes:
    type: array
    required: true
  low-speed:
    type: int
    required: true
  high-speed:
    type: int
    required: true
  timeout-ms:
    type: int
    required: true
  minimum-dt-ms:
    type: int
    required: true
  slow-multiplier:
    type: int
    required: true
  slow-divisor:
    type: int
    required: true
  medium-multiplier:
    type: int
    required: true
  medium-divisor:
    type: int
    required: true
  fast-multiplier:
    type: int
    required: true
  fast-divisor:
    type: int
    required: true
```

## module/Kconfig
```kconfig
config CHARYBDIS_LED_RENDERER
    bool "Build Charybdis LED renderer"
    select LED_STRIP
    select SPI
    select WS2812_STRIP

rsource "drivers/Kconfig"
```

## module/drivers/input/Kconfig
```kconfig
if INPUT

config ZMK_INPUT_PROCESSOR_SPEED_SCALER
    bool "ZMK input processor speed scaler"
    default y
    depends on DT_HAS_ZMK_INPUT_PROCESSOR_SPEED_SCALER_ENABLED

endif
```
